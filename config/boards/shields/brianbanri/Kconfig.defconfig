## config/boards/shields/brianbanri/Kconfig.defconfig
```kconfig
if SHIELD_BRIANBANRI_LEFT

config ZMK_KEYBOARD_NAME
    default "brian_kb"

config ZMK_SPLIT_ROLE_CENTRAL
    default y

endif

if SHIELD_BRIANBANRI_LEFT || SHIELD_BRIANBANRI_RIGHT

config ZMK_SPLIT
    default y

endif
```

## config/boards/shields/brianbanri/Kconfig.shield
```kconfig
config SHIELD_BRIANBANRI_LEFT
    def_bool $(shields_list_contains, brianbanri_left)

config SHIELD_BRIANBANRI_RIGHT
    def_bool $(shields_list_contains, brianbanri_right)
```
